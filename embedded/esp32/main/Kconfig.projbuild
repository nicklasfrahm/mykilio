## embedded/esp32/main/Kconfig.projbuild
```kconfig
menu "I2C"

    config I2C_CONTROLLER_SCL
        int "SCL GPIO number"
        default 6 if IDF_TARGET_ESP32C3
        default 2 if IDF_TARGET_ESP32 || IDF_TARGET_ESP32S2 || IDF_TARGET_ESP32S3
        help
            GPIO number for I2C controller clock line.
        
    config I2C_CONTROLLER_SDA
        int "SDA GPIO number"
        default 5 if IDF_TARGET_ESP32C3
        default 4 if IDF_TARGET_ESP32 || IDF_TARGET_ESP32S2 || IDF_TARGET_ESP32S3
        help
            GPIO number for I2C controller data line.
        
    config I2C_CONTROLLER_PORT_NUM
        int "Port number"
        default 1 if IDF_TARGET_ESP32 || IDF_TARGET_ESP32S2 || IDF_TARGET_ESP32S3
        default 0 if IDF_TARGET_ESP32C3
        help
            Port number for I2C controller device.
        
    config I2C_CONTROLLER_FREQUENCY
        int "Controller clock frequency"
        default 100000
        help
            TWI speed of controller device.

endmenu

menu "MQTT"

    config MQTT_URI
        string "Broker URL"
        default "mqtts://alpha.mykilio.optrin.net:8883"
        help
            URL of an mqtt broker which this device connects to.

    config MQTT_USERNAME
        string "Username"
        default "username"
        help
            Username to use while connecting to the MQTT broker.

    config MQTT_PASSWORD
        string "Password"
        default "password"
        help
            Password to use while connecting to the MQTT broker.

endmenu
```
